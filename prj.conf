## CMakeLists.txt
```
cmake_minimum_required(VERSION 3.20.0)

find_package(Zephyr REQUIRED HINTS $ENV{ZEPHYR_BASE})
project(my_led_control)

target_sources(app PRIVATE src/main.c)
```

## prj.conf
```kconfig
# Core Configuration
CONFIG_MAIN_STACK_SIZE=2048
CONFIG_IDLE_STACK_SIZE=1024
CONFIG_LOG=y
CONFIG_LOG_DEFAULT_LEVEL=1

# Networking
CONFIG_NETWORKING=y
CONFIG_NET_IPV4=y
CONFIG_NET_TCP=y
CONFIG_NET_SOCKETS=y
CONFIG_NET_LOG=n

# WiFi
CONFIG_WIFI=y
CONFIG_WIFI_ESP32=y
CONFIG_WIFI_LOG_LEVEL_ERR=y
CONFIG_ESP32_WIFI=y
CONFIG_ESP32_WIFI_STA=y

# Filesystem
CONFIG_FILE_SYSTEM=y
CONFIG_FILE_SYSTEM_LITTLEFS=y
CONFIG_FLASH=y
CONFIG_FLASH_MAP=y
CONFIG_FLASH_PAGE_LAYOUT=y

# LED Strip
CONFIG_LED_STRIP=y
CONFIG_WS2812_STRIP=y

# WebSocket
CONFIG_WEBSOCKET_CLIENT=y

# ESP32 Specific
CONFIG_ESP32_SPI=y
CONFIG_ESP32_SPI_GPIO_CS=y
```

## boards/esp32c3_supermini.overlay
```dts
/dts-v1/;
/ {
    leds {
        compatible = "worldsemi,ws2812";
        label = "WS2812";
        chain-length = <10>; // Number of LEDs
        spi-bus = <&spi0>;
        data-gpios = <&gpio0 2 GPIO_ACTIVE_HIGH>; // DATA_PIN = GPIO2
    };
};
```

## src/main.c
```c
#include <zephyr.h>
#include <drivers/led_strip.h>
#include <logging/log.h>
#include "config.h"

LOG_MODULE_REGISTER(main);

// LED Control
static const struct device *led_strip;
static uint8_t brightness = DEFAULT_BRIGHTNESS;
static bool power_on = true;
static char current_mode[16] = "solid"; // solid, rainbow, pulse
static uint32_t current_color = DEFAULT_COLOR;

// Initialize LED Strip
void init_led_strip(void) {
    led_strip = DEVICE_DT_GET(DT_ALIAS(led_strip));
    if (!device_is_ready(led_strip)) {
        LOG_ERR("LED strip device not ready");
        return;
    }
    LOG_INF("LED strip initialized");
}

// Apply LED Settings
void apply_led_settings(void) {
    struct led_rgb pixels[NUM_LEDS];

    if (!power_on) {
        memset(pixels, 0, sizeof(pixels));
    } else if (strcmp(current_mode, "solid") == 0) {
        uint8_t r = (current_color >> 16) & 0xFF;
        uint8_t g = (current_color >> 8) & 0xFF;
        uint8_t b = current_color & 0xFF;
        for (int i = 0; i < NUM_LEDS; i++) {
            pixels[i].r = r;
            pixels[i].g = g;
            pixels[i].b = b;
        }
    } else if (strcmp(current_mode, "rainbow") == 0) {
        static uint8_t hue = 0;
        for (int i = 0; i < NUM_LEDS; i++) {
            pixels[i] = hsv_to_rgb((hue + (i * 256 / NUM_LEDS)) % 256, 255, 255);
        }
        hue++;
    } else if (strcmp(current_mode, "pulse") == 0) {
        static uint8_t brightness_mod = 0;
        static int direction = 1;
        brightness_mod += direction;
        if (brightness_mod == 255 || brightness_mod == 0) direction = -direction;
        uint8_t r = (current_color >> 16) & 0xFF;
        uint8_t g = (current_color >> 8) & 0xFF;
        uint8_t b = current_color & 0xFF;
        for (int i = 0; i < NUM_LEDS; i++) {
            pixels[i].r = r * brightness_mod / 255;
            pixels[i].g = g * brightness_mod / 255;
            pixels[i].b = b * brightness_mod / 255;
        }
    }

    led_strip_update_rgb(led_strip, pixels, NUM_LEDS);
}

// Main Function
void main(void) {
    LOG_INF("Starting LED Control Application");

    // Initialize LED Strip
    init_led_strip();

    // Main Loop
    while (1) {
        apply_led_settings();
        k_sleep(K_MSEC(20));
    }
}
```

## include/config.h
```c
#ifndef CONFIG_H
#define CONFIG_H

// Hardware Configuration
#define NUM_LEDS 10
#define DATA_PIN 2

// WiFi Configuration
#define WIFI_SSID "YOUR_SSID"
#define WIFI_PASSWORD "YOUR_PASSWORD"

// LED Control
#define DEFAULT_BRIGHTNESS 127
#define DEFAULT_COLOR 0xFF0000 // Red

#endif // CONFIG_H
```
